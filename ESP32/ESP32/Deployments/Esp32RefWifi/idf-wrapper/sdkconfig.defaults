## ESP32/ESP32/Deployments/Esp32RefWifi/idf-wrapper/sdkconfig.defaults
```kconfig
CONFIG_IDF_TARGET="esp32"
CONFIG_FREERTOS_HZ=1000
CONFIG_PARTITION_TABLE_CUSTOM=y
CONFIG_PARTITION_TABLE_CUSTOM_FILENAME="partitions_fprime.csv"
# CONFIG_ESP_WIFI_STATIC_RX_BUFFER_NUM=6
# CONFIG_ESP_WIFI_DYNAMIC_RX_BUFFER_NUM=16
# CONFIG_ESP_WIFI_DYNAMIC_TX_BUFFER_NUM=16
# CONFIG_ESP_WIFI_MGMT_SBUF_NUM=8
CONFIG_ESP_WIFI_STATIC_RX_BUFFER_NUM=4
CONFIG_ESP_WIFI_DYNAMIC_RX_BUFFER_NUM=8
CONFIG_ESP_WIFI_DYNAMIC_TX_BUFFER_NUM=8
CONFIG_ESP_WIFI_MGMT_SBUF_NUM=8
CONFIG_ESP_WIFI_STA_DISCONNECTED_PM_ENABLE=n
CONFIG_LWIP_IPV6=n
CONFIG_LWIP_MAX_SOCKETS=4
```
